## CMakeLists.txt
```
cmake_minimum_required(VERSION 3.20.0)

find_package(Zephyr REQUIRED HINTS $ENV{ZEPHYR_BASE})
project(benchmark)
target_include_directories(app PRIVATE include )
target_sources(app PRIVATE src/main.c src/timer2.c src/matrix15.c src/pps.c src/mpu6050.c src/uart_benchmark.c
src/sdcard.c)
```

## prj.conf
```kconfig
CONFIG_SERIAL=y
CONFIG_CONSOLE=y
CONFIG_UART_CONSOLE=y

CONFIG_PRINTK=y

CONFIG_MAIN_STACK_SIZE=4096

CONFIG_I2C=y
CONFIG_GPIO=y
CONFIG_SPI=y

CONFIG_SDHC=y

CONFIG_FILE_SYSTEM=y
CONFIG_FAT_FILESYSTEM_ELM=y

CONFIG_SPI_STM32=y

CONFIG_SERIAL=y
CONFIG_UART_CONSOLE=y
CONFIG_UART_INTERRUPT_DRIVEN=n

CONFIG_DISK_ACCESS=y
CONFIG_DISK_DRIVER_SDMMC=y

CONFIG_FILE_SYSTEM=y
CONFIG_LOG=y
```

## src/main.c
```c
#include <zephyr/kernel.h>
#include <zephyr/sys/printk.h>

#include "matrix15.h"
#include "pps.h"
#include "mpu6050.h"
#include "uart_benchmark.h"
#include "sdcard.h"

int main(void)
{
    printk("Zephyr Benchmark Suite\n");

    matrix_start();
    pps_start();
    mpu6050_start();
    uart_benchmark_start();
    sdcard_start();

    while (1) {
        k_sleep(K_FOREVER);
    }

    return 0;
}
```

## include/matrix15.h
```c
#ifndef MATRIX15_H
#define MATRIX15_H

#define N 15

static float A[N][N] = {
    {1.2f, 2.5f, 3.1f, 4.7f, 5.9f, 6.3f, 7.8f, 8.4f, 9.6f, 1.5f, 2.8f, 3.9f, 4.2f, 5.1f, 6.7f},
    {2.1f, 3.8f, 4.2f, 5.5f, 6.7f, 7.1f, 8.9f, 9.3f, 1.4f, 2.6f, 3.5f, 4.8f, 5.7f, 6.2f, 7.9f},
    {3.4f, 4.6f, 5.8f, 6.1f, 7.5f, 8.2f, 9.7f, 1.3f, 2.9f, 3.6f, 4.4f, 5.2f, 6.8f, 7.3f, 8.5f},
    {4.3f, 5.7f, 6.9f, 7.2f, 8.6f, 9.1f, 1.8f, 2.5f, 3.7f, 4.1f, 5.6f, 6.4f, 7.8f, 8.2f, 9.9f},
    {5.1f, 6.4f, 7.3f, 8.5f, 9.2f, 1.6f, 2.8f, 3.4f, 4.9f, 5.3f, 6.7f, 7.1f, 8.8f, 9.5f, 1.2f},
    {6.5f, 7.9f, 8.1f, 9.4f, 1.3f, 2.6f, 3.8f, 4.7f, 5.2f, 6.9f, 7.4f, 8.3f, 9.1f, 1.7f, 2.5f},
    {7.6f, 8.2f, 9.5f, 1.4f, 2.7f, 3.1f, 4.8f, 5.9f, 6.3f, 7.5f, 8.6f, 9.2f, 1.8f, 2.4f, 3.7f},
    {8.3f, 9.6f, 1.2f, 2.5f, 3.9f, 4.6f, 5.1f, 6.8f, 7.4f, 8.7f, 9.3f, 1.5f, 2.9f, 3.2f, 4.8f},
    {9.1f, 1.8f, 2.4f, 3.7f, 4.5f, 5.2f, 6.9f, 7.6f, 8.1f, 9.8f, 1.4f, 2.3f, 3.5f, 4.7f, 5.6f},
    {1.7f, 2.9f, 3.3f, 4.8f, 5.1f, 6.5f, 7.2f, 8.4f, 9.6f, 1.3f, 2.8f, 3.4f, 4.9f, 5.7f, 6.1f},
    {2.6f, 3.1f, 4.7f, 5.9f, 6.4f, 7.8f, 8.5f, 9.2f, 1.6f, 2.3f, 3.9f, 4.5f, 5.8f, 6.7f, 7.4f},
    {3.5f, 4.2f, 5.6f, 6.8f, 7.1f, 8.9f, 9.4f, 1.7f, 2.5f, 3.6f, 4.8f, 5.3f, 6.9f, 7.2f, 8.1f},
    {4.9f, 5.3f, 6.7f, 7.4f, 8.2f, 9.5f, 1.1f, 2.8f, 3.4f, 4.6f, 5.9f, 6.2f, 7.7f, 8.5f, 9.3f},
    {5.8f, 6.1f, 7.5f, 8.3f, 9.7f, 1.2f, 2.6f, 3.5f, 4.1f, 5.4f, 6.8f, 7.9f, 8.2f, 9.6f, 1.5f},
    {6.2f, 7.8f, 8.4f, 9.1f, 1.9f, 2.7f, 3.6f, 4.2f, 5.5f, 6.3f, 7.1f, 8.8f, 9.4f, 1.6f, 2.9f}
};

static float B[N][N] = {
    {9.5f,8.2f,7.3f,6.1f,5.7f,4.4f,3.6f,2.5f,1.8f,9.1f,8.7f,7.5f,6.3f,5.2f,4.8f},
    {8.4f,7.1f,6.5f,5.3f,4.9f,3.7f,2.8f,1.6f,9.2f,8.5f,7.4f,6.2f,5.8f,4.6f,3.1f},
    {7.9f,6.4f,5.2f,4.1f,3.8f,2.5f,1.7f,9.6f,8.4f,7.2f,6.8f,5.5f,4.3f,3.9f,2.6f},
    {6.8f,5.7f,4.4f,3.2f,2.9f,1.5f,9.8f,8.3f,7.6f,6.1f,5.4f,4.7f,3.5f,2.2f,1.9f},
    {5.6f,4.8f,3.7f,2.4f,1.3f,9.7f,8.2f,7.1f,6.5f,5.9f,4.6f,3.8f,2.7f,1.4f,9.3f},
    {4.7f,3.5f,2.8f,1.6f,9.5f,8.4f,7.3f,6.2f,5.1f,4.9f,3.7f,2.5f,1.8f,9.6f,8.3f},
    {3.9f,2.7f,1.5f,9.2f,8.8f,7.6f,6.4f,5.3f,4.1f,3.8f,2.6f,1.4f,9.9f,8.5f,7.2f},
    {2.8f,1.9f,9.4f,8.3f,7.5f,6.1f,5.8f,4.7f,3.2f,2.4f,1.6f,9.1f,8.6f,7.4f,6.5f},
    {1.7f,9.6f,8.2f,7.1f,6.3f,5.4f,4.5f,3.8f,2.6f,1.5f,9.3f,8.7f,7.2f,6.4f,5.1f},
    {9.8f,8.5f,7.6f,6.2f,5.3f,4.7f,3.4f,2.1f,1.9f,9.4f,8.1f,7.5f,6.8f,5.6f,4.2f},
    {8.3f,7.4f,6.5f,5.7f,4.6f,3.2f,2.9f,1.7f,9.8f,8.6f,7.1f,6.4f,5.5f,4.3f,3.8f},
    {7.5f,6.1f,5.4f,4.3f,3.8f,2.7f,1.4f,9.2f,8.7f,7.6f,6.2f,5.9f,4.8f,3.5f,2.1f},
    {6.2f,5.8f,4.1f,3.7f,2.5f,1.8f,9.6f,8.4f,7.2f,6.5f,5.3f,4.6f,3.4f,2.9f,1.7f},
    {5.1f,4.4f,3.2f,2.6f,1.9f,9.3f,8.5f,7.4f,6.8f,5.7f,4.2f,3.1f,2.8f,1.6f,9.5f},
    {4.3f,3.6f,2.7f,1.8f,9.4f,8.1f,7.5f,6.3f,5.2f,4.8f,3.9f,2.4f,1.5f,9.7f,8.6f}
};

static float C[N][N];

void matrix_start(void);

#endif
```

## include/pps.h
```c
#ifndef PPS_H
#define PPS_H

void pps_start(void);

#endif /* PPS_H */
```

## include/sdcard.h
```c
#ifndef SDCARD_H
#define SDCARD_H

void sdcard_start(void);

#endif /* SDCARD_H */
```

## src/matrix15.c
```c
#include <zephyr/kernel.h>
#include <zephyr/sys/printk.h>

#include "matrix15.h"

#define MATRIX_STACK_SIZE 2048
#define MATRIX_PRIORITY   5

K_THREAD_STACK_DEFINE(matrix_stack, MATRIX_STACK_SIZE);
static struct k_thread matrix_thread;

void matrix_thread_fn(void *p1, void *p2, void *p3)
{
    ARG_UNUSED(p1);
    ARG_UNUSED(p2);
    ARG_UNUSED(p3);

    uint64_t start;
    uint64_t end;
    uint64_t cycles;
    uint64_t time_us;

    uint64_t min_cy = UINT64_MAX;
    uint64_t max_cy = 0;
    uint64_t total_cycles = 0;
    uint64_t iteration = 0;

    while (1)
    {
        start = k_cycle_get_64();

        for (int i = 0; i < N; i++)
        {
            for (int j = 0; j < N; j++)
            {
                C[i][j] = 0.0f;

                for (int k = 0; k < N; k++)
                {
                    C[i][j] += A[i][k] * B[k][j];
                }
            }
        }

        end = k_cycle_get_64();

        cycles = end - start;
        time_us = k_cyc_to_us_floor64(cycles);

        iteration++;
        total_cycles += cycles;

        if (cycles < min_cy)
            min_cy = cycles;

        if (cycles > max_cy)
            max_cy = cycles;

        printk("\n========== MATRIX BENCHMARK ==========\n");
        printk("Iteration : %llu\n", iteration);
        printk("Cycles    : %llu\n", cycles);
        printk("Time      : %llu us\n", time_us);
        printk("Minimum   : %llu\n", min_cy);
        printk("Maximum   : %llu\n", max_cy);
        printk("Average   : %llu\n", total_cycles / iteration);

        k_sleep(K_SECONDS(1));
    }
}

void matrix_start(void)
{
    k_thread_create(&matrix_thread,
                    matrix_stack,
                    K_THREAD_STACK_SIZEOF(matrix_stack),
                    matrix_thread_fn,
                    NULL,
                    NULL,
                    NULL,
                    MATRIX_PRIORITY,
                    0,
                    K_NO_WAIT);
}
```

## src/mpu6050.c
```c
#include <zephyr/kernel.h>
#include <zephyr/drivers/gpio.h>
#include <zephyr/drivers/i2c.h>

#include "mpu6050.h"

#define MPU_STACK_SIZE 1024
#define MPU_PRIORITY   3

K_SEM_DEFINE(mpu_sem, 0, 1);

K_THREAD_STACK_DEFINE(mpu_stack, MPU_STACK_SIZE);
static struct k_thread mpu_thread;

static void mpu_thread_fn(void *p1, void *p2, void *p3)
{
    ARG_UNUSED(p1);
    ARG_UNUSED(p2);
    ARG_UNUSED(p3);

    while (1) {
        k_sem_take(&mpu_sem, K_FOREVER);
    }
}

void mpu6050_init(void)
{
}

uint64_t mpu6050_read(uint8_t *imu_data)
{
    ARG_UNUSED(imu_data);
    return 0;
}

void mpu6050_start(void)
{
    mpu6050_init();

    k_thread_create(&mpu_thread,
                    mpu_stack,
                    K_THREAD_STACK_SIZEOF(mpu_stack),
                    mpu_thread_fn,
                    NULL,
                    NULL,
                    NULL,
                    MPU_PRIORITY,
                    0,
                    K_NO_WAIT);
}
```

## src/uart_benchmark.c
```c
#include <zephyr/kernel.h>

#include "uart_benchmark.h"

#define UART_STACK_SIZE 1024
#define UART_PRIORITY   6

K_THREAD_STACK_DEFINE(uart_stack, UART_STACK_SIZE);
static struct k_thread uart_thread;

static void uart_thread_fn(void *p1, void *p2, void *p3)
{
    ARG_UNUSED(p1);
    ARG_UNUSED(p2);
    ARG_UNUSED(p3);

    while (1) {
        k_sleep(K_MSEC(100));
    }
}

void uart_benchmark_start(void)
{
    k_thread_create(&uart_thread,
                    uart_stack,
                    K_THREAD_STACK_SIZEOF(uart_stack),
                    uart_thread_fn,
                    NULL,
                    NULL,
                    NULL,
                    UART_PRIORITY,
                    0,
                    K_NO_WAIT);
}
```
